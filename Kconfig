## Kconfig
```kconfig
menu "LED Subsystem"

choice BLINK_SLEEP
 prompt "LED blink sleep time"
 default BLINK_SLEEP_250MS

config BLINK_SLEEP_250MS
bool "Fast (250ms)"

config BLINK_SLEEP_1000MS
bool "Medium (1s)"

config BLINK_SLEEP_2000MS
bool "Slow (2s)"

endchoice

menu "Advanced LED Settings"
    config LED_BRIGHTNESS
    int "LED brightness"
    default 100
    range 0 100

    config LED_FADE_DURATION
    int "LED Fade Duration (ms)"
    default 500

    menu "Expert Settings"
        config LED_DEBUGGING
        bool "Enable LED debugging"

        config LED_CUSTOM_BLINK
        bool "Custom blink pattern"
    endmenu
endmenu

endmenu

source "Kconfig.zephyr"
```

## app/boards/esp32_devkitc_foo/Kconfig.esp32_devkitc_foo
```kconfig
# Copyright (c) 2023-2025 Espressif Systems (Shanghai) Co., Ltd.
# SPDX-License-Identifier: Apache-2.0

config BOARD_ESP32_DEVKITC_FOO
	select SOC_ESP32_WROVER_E_N4R8
	select SOC_ESP32_PROCPU if BOARD_ESP32_DEVKITC_FOO_ESP32_PROCPU
```

## app/boards/esp32_devkitc_foo/board.yml
```yaml
board:
  name: esp32_devkitc_foo
  full_name: ESP32-DevKitC
  vendor: espressif
  socs:
    - name: esp32
```
