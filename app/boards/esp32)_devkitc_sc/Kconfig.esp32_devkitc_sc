## app/boards/esp32)_devkitc_sc/Kconfig.esp32_devkitc_sc
```kconfig
# Copyright (c) 2023-2025 Espressif Systems (Shanghai) Co., Ltd.
# SPDX-License-Identifier: Apache-2.0

config BOARD_ESP32_DEVKITC_SC
	select SOC_ESP32
	select SOC_ESP32_PROCPU if BOARD_ESP32_DEVKITC_ESP32_PROCPU || \
		BOARD_ESP32_DEVKITC_ESP32_PROCPU_QEMU
	select SOC_ESP32_PROCPU if BOARD_ESP32_DEVKITC_ESP32_PROCPU
	select SOC_ESP32_APPCPU if BOARD_ESP32_DEVKITC_ESP32_APPCPU

config HEAP_MEM_POOL_ADD_SIZE_BOARD
	int
	default 4096 if BOARD_ESP32_DEVKITC_SC_ESP32_PROCPU
```

## app/boards/esp32)_devkitc_sc/board.yml
```yaml
board:
  name: esp32_devkitc_sc
  full_name: ESP32-DevKitC
  vendor: espressif
  socs:
    - name: esp32
      variants:
        - name: qemu
          cpucluster: procpu
```
